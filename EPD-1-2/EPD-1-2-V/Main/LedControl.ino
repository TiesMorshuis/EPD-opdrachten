int CONTROLLED_PINARRAY[] = {6, 7, 8, 9, 10, 11, 12, 13};
int CONTROLLED_GET_PINARRAY (){
  return CONTROLLED_PINARRAY;
}

int CONTROLLED_GET_PINARRAY_SIZE (){
  int CONTROLLED_PINARRAY_SIZE = sizeof(CONTROLLED_PINARRAY);
  return CONTROLLED_PINARRAY_SIZE;
}

void CONTROLLED_SETUP(int CONTROLLED_PINARRAY[], int CONTROLLED_PINARRAY_SIZE){
  for (int i = 0; i < CONTROLLED_PINARRAY_SIZE; i++){
    pinMode(CONTROLLED_PINARRAY[i], OUTPUT);
  }
}

void CONTROLLED_ON (int CONTROLLED_PINNR){
  digitalWrite(CONTROLLED_PINNR, HIGH);
}

void CONTROLLED_OFF (int CONTROLLED_PINNR){
  digitalWrite(CONTROLLED_PINNR, LOW);
}

void CONTROLLED_ALL_ON(int CONTROLLED_PINARRAY[]){
  for (int index = 0; index < CONTROLLED_GET_PINARRAY_SIZE(); index++){
    digitalWrite(CONTROLLED_PINARRAY[index], HIGH);
  }
}

void CONTROLLED_ALL_OFF(int CONTROLLED_PINARRAY[]){
  for (int index = 0; index < CONTROLLED_GET_PINARRAY_SIZE(); index++){
    digitalWrite(CONTROLLED_PINARRAY[index], LOW);
  }
}